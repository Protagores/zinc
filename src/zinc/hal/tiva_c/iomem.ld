INCLUDE ./src/zinc/hal/cortex_m3/armmem.ld

PROVIDE(isr_gpio_port_a    = isr_default_fault);
PROVIDE(isr_gpio_port_b    = isr_default_fault);
PROVIDE(isr_gpio_port_c    = isr_default_fault);
PROVIDE(isr_gpio_port_d    = isr_default_fault);
PROVIDE(isr_gpio_port_e    = isr_default_fault);
PROVIDE(isr_uart_0         = isr_default_fault);
PROVIDE(isr_uart_1         = isr_default_fault);
PROVIDE(isr_ssi_0          = isr_default_fault);
PROVIDE(isr_i2c_0          = isr_default_fault);
PROVIDE(isr_pwm_0_fault    = isr_default_fault);
PROVIDE(isr_pwm_0_gen_0    = isr_default_fault);
PROVIDE(isr_pwm_0_gen_1    = isr_default_fault);
PROVIDE(isr_pwm_0_gen_2    = isr_default_fault);
PROVIDE(isr_qei_0          = isr_default_fault);
PROVIDE(isr_adc_0_seq_0    = isr_default_fault);
PROVIDE(isr_adc_0_seq_1    = isr_default_fault);
PROVIDE(isr_adc_0_seq_2    = isr_default_fault);
PROVIDE(isr_adc_0_seq_3    = isr_default_fault);
PROVIDE(isr_wdt            = isr_default_fault);
PROVIDE(isr_timer_0_a      = isr_default_fault);
PROVIDE(isr_timer_0_b      = isr_default_fault);
PROVIDE(isr_timer_1_a      = isr_default_fault);
PROVIDE(isr_timer_1_b      = isr_default_fault);
PROVIDE(isr_timer_2_a      = isr_default_fault);
PROVIDE(isr_timer_2_b      = isr_default_fault);
PROVIDE(isr_aco_0          = isr_default_fault);
PROVIDE(isr_aco_1          = isr_default_fault);
PROVIDE(isr_aco_2          = isr_default_fault);
PROVIDE(isr_system_control = isr_default_fault);
PROVIDE(isr_flash_eeprom   = isr_default_fault);
PROVIDE(isr_gpio_port_f    = isr_default_fault);
PROVIDE(isr_gpio_port_g    = isr_default_fault);
PROVIDE(isr_gpio_port_h    = isr_default_fault);
PROVIDE(isr_uart_2         = isr_default_fault);
PROVIDE(isr_ssi_1          = isr_default_fault);
PROVIDE(isr_timer_3_a      = isr_default_fault);
PROVIDE(isr_timer_3_b      = isr_default_fault);
PROVIDE(isr_i2c_1          = isr_default_fault);
PROVIDE(isr_qei_1          = isr_default_fault);
PROVIDE(isr_can_0          = isr_default_fault);
PROVIDE(isr_can_1          = isr_default_fault);
PROVIDE(isr_hibernation    = isr_default_fault);
PROVIDE(isr_usb_0          = isr_default_fault);
PROVIDE(isr_pwm_0_gen_3    = isr_default_fault);
PROVIDE(isr_udma_software  = isr_default_fault);
PROVIDE(isr_udma_error     = isr_default_fault);
PROVIDE(isr_adc_1_seq_0    = isr_default_fault);
PROVIDE(isr_adc_1_seq_1    = isr_default_fault);
PROVIDE(isr_adc_1_seq_2    = isr_default_fault);
PROVIDE(isr_adc_1_seq_3    = isr_default_fault);
PROVIDE(isr_gpio_port_j    = isr_default_fault);
PROVIDE(isr_gpio_port_k    = isr_default_fault);
PROVIDE(isr_gpio_port_l    = isr_default_fault);
PROVIDE(isr_ssi_2          = isr_default_fault);
PROVIDE(isr_ssi_3          = isr_default_fault);
PROVIDE(isr_uart_3         = isr_default_fault);
PROVIDE(isr_uart_4         = isr_default_fault);
PROVIDE(isr_uart_5         = isr_default_fault);
PROVIDE(isr_uart_6         = isr_default_fault);
PROVIDE(isr_uart_7         = isr_default_fault);
PROVIDE(isr_i2c_2          = isr_default_fault);
PROVIDE(isr_i2c_3          = isr_default_fault);
PROVIDE(isr_timer_4_a      = isr_default_fault);
PROVIDE(isr_timer_4_b      = isr_default_fault);
PROVIDE(isr_timer_5_a      = isr_default_fault);
PROVIDE(isr_timer_5_b      = isr_default_fault);
PROVIDE(isr_wtimer_0_a     = isr_default_fault);
PROVIDE(isr_wtimer_0_b     = isr_default_fault);
PROVIDE(isr_wtimer_1_a     = isr_default_fault);
PROVIDE(isr_wtimer_1_b     = isr_default_fault);
PROVIDE(isr_wtimer_2_a     = isr_default_fault);
PROVIDE(isr_wtimer_2_b     = isr_default_fault);
PROVIDE(isr_wtimer_3_a     = isr_default_fault);
PROVIDE(isr_wtimer_3_b     = isr_default_fault);
PROVIDE(isr_wtimer_4_a     = isr_default_fault);
PROVIDE(isr_wtimer_4_b     = isr_default_fault);
PROVIDE(isr_wtimer_5_a     = isr_default_fault);
PROVIDE(isr_wtimer_5_b     = isr_default_fault);
PROVIDE(isr_fpu_exception  = isr_default_fault);
PROVIDE(isr_i2c_4          = isr_default_fault);
PROVIDE(isr_i2c_5          = isr_default_fault);
PROVIDE(isr_gpio_port_m    = isr_default_fault);
PROVIDE(isr_gpio_port_n    = isr_default_fault);
PROVIDE(isr_qei_2          = isr_default_fault);
PROVIDE(isr_gpio_port_p0   = isr_default_fault);
PROVIDE(isr_gpio_port_p1   = isr_default_fault);
PROVIDE(isr_gpio_port_p2   = isr_default_fault);
PROVIDE(isr_gpio_port_p3   = isr_default_fault);
PROVIDE(isr_gpio_port_p4   = isr_default_fault);
PROVIDE(isr_gpio_port_p5   = isr_default_fault);
PROVIDE(isr_gpio_port_p6   = isr_default_fault);
PROVIDE(isr_gpio_port_p7   = isr_default_fault);
PROVIDE(isr_gpio_port_q0   = isr_default_fault);
PROVIDE(isr_gpio_port_q1   = isr_default_fault);
PROVIDE(isr_gpio_port_q2   = isr_default_fault);
PROVIDE(isr_gpio_port_q3   = isr_default_fault);
PROVIDE(isr_gpio_port_q4   = isr_default_fault);
PROVIDE(isr_gpio_port_q5   = isr_default_fault);
PROVIDE(isr_gpio_port_q6   = isr_default_fault);
PROVIDE(isr_gpio_port_q7   = isr_default_fault);
PROVIDE(isr_gpio_port_r    = isr_default_fault);
PROVIDE(isr_gpio_port_s    = isr_default_fault);
PROVIDE(isr_pwm_1_gen_0    = isr_default_fault);
PROVIDE(isr_pwm_1_gen_1    = isr_default_fault);
PROVIDE(isr_pwm_1_gen_2    = isr_default_fault);
PROVIDE(isr_pwm_1_gen_3    = isr_default_fault);
PROVIDE(isr_pwm_1_fault    = isr_default_fault);

